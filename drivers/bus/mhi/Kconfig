## drivers/bus/mhi/Kconfig
```kconfig
# SPDX-License-Identifier: GPL-2.0
#
# MHI bus
#
# Copyright (c) 2021, Linaro Ltd.
#

config MHI_BUS_MISC
	bool "Support for miscellaneous MHI features"
	depends on MHI_BUS
	help
	  Miscellaneous features support for MHI Bus driver includes IPC logs,
	  introduction of a list of controllers for debug using ramdumps and
	  other features not present upstream such as Dynamic Resource Vote,
	  SFR parsing using RDDM dumps, scanning for the RDDM cookie and more.

source "drivers/bus/mhi/devices/Kconfig"
source "drivers/bus/mhi/controllers/Kconfig"
source "drivers/bus/mhi/host/Kconfig"
```

## drivers/nothing_stability/Kconfig
```kconfig
config NOTHING_BOOTLOADER_LOG
	tristate "Nothing bootloader log driver"
	default n
	help
		show booloader_log under proc/bootloader_log

config NOTHING_RESTART_HANDLER
	tristate "Nothing power-off function enhance"
	default n
	help
	  store restart info into imem.

config NOTHING_TASK_MEMINFO
	tristate "Nothing show all task memory info driver"
	default n
	help
		cat /proc/nt_meminfo/show_all_tasks will show all task meminfo

config NOTHING_SECURE_ELEMENT
	tristate "Nothing secure state"
	default n
	help
		This driver getting secure info from hw which setting up in early stage.
```

## drivers/staging/qcacld-3.0/Kconfig
```kconfig
comment "Qualcomm Atheros CLD WLAN module"

config QCA_CLD_WLAN
	tristate "Qualcomm Atheros CLD WLAN module"
	default n
	help
	  Add support for the Qualcomm Atheros CLD WLAN module

if QCA_CLD_WLAN != n

config QCA_CLD_WLAN_PROFILE
	string "Configuration profile for Qualcomm Atheros CLD WLAN module"
	default "default"
	help
	  Specify which configuration profile to be used for building
	  this module.

	  Profiles are located at drivers/staging/qcacld-3.0/configs.

config QCA_CLD_WLAN_DYNAMIC_SINGLE_CHIP_NAME
	string "Dynamic single chip name for the Qualcomm Atheros CLD WLAN module"
	default ""
	help
	  Specify the chip name to be used by the Qualcomm Atheros CLD WLAN
	  module.

	  This is used to load the userspace WCNSS_qcom_cfg.ini from a
	  certain subfolder.
	  It will load from
	  /vendor/firmware/wlan/qca_cld/<QCA_CLD_WLAN_DYNAMIC_SINGLE_CHIP_NAME>

endif # QCA_CLD_WLAN
```
